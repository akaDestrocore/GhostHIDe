## CMakeLists.txt
```
cmake_minimum_required(VERSION 3.28.1)

find_package(Zephyr REQUIRED HINTS $ENV{ZEPHYR_BASE})
project(ch375_unit_tests)

add_compile_options(-Wno-error=deprecated-declarations)

get_filename_component(PROJECT_ROOT ${CMAKE_CURRENT_SOURCE_DIR}/../../.. ABSOLUTE)

# Include stubs first
target_include_directories(app BEFORE PRIVATE
    ${CMAKE_CURRENT_SOURCE_DIR}/stubs
)

# Include directories
target_include_directories(app PRIVATE
    ${PROJECT_ROOT}/drivers/ch375/include
    ${PROJECT_ROOT}/drivers/hid/include
    ${CMAKE_CURRENT_SOURCE_DIR}/mocks
)

# Source files for test
target_sources(app PRIVATE
    ${PROJECT_ROOT}/drivers/ch375/src/ch375.c
    ${PROJECT_ROOT}/drivers/ch375/src/ch375_host.c
    ${PROJECT_ROOT}/drivers/hid/src/hid_parser.c
    ${PROJECT_ROOT}/drivers/hid/src/hid_mouse.c
    ${PROJECT_ROOT}/drivers/hid/src/hid_keyboard.c
    
)

# Mocks
target_sources(app PRIVATE
    ${CMAKE_CURRENT_SOURCE_DIR}/mocks/mock_ch375_hw.c
)

# Test files
target_sources(app PRIVATE
    ${CMAKE_CURRENT_SOURCE_DIR}/src/test_ch375_core.c
    ${CMAKE_CURRENT_SOURCE_DIR}/src/test_descriptors.c
    ${CMAKE_CURRENT_SOURCE_DIR}/src/test_transfers.c
    ${CMAKE_CURRENT_SOURCE_DIR}/src/test_hid_parser.c
    ${CMAKE_CURRENT_SOURCE_DIR}/src/test_hid_mouse.c
    ${CMAKE_CURRENT_SOURCE_DIR}/src/test_hid_keyboard.c
)
```

## prj.conf
```kconfig
CONFIG_ZTEST=y
CONFIG_LOG=y
CONFIG_LOG_MODE_MINIMAL=y
CONFIG_LOG_DEFAULT_LEVEL=0

CONFIG_MAIN_STACK_SIZE=4096
CONFIG_HEAP_MEM_POOL_SIZE=16384

CONFIG_ASSERT=y

CONFIG_MULTITHREADING=y

CONFIG_SYS_CLOCK_EXISTS=y
```

## src/test_ch375_core.c
```c
/* SPDX-License-Identifier: GPL-3.0-or-later */
/**
 * ╔═══════════════════════════════════════════════════════════════════════╗
 * ║                          GhostHIDe Project                            ║
 * ╚═══════════════════════════════════════════════════════════════════════╝
 * 
 * @file           test_ch375_core.c
 * @brief          CH375 core protocol unit tests
 * 
 * @author         destrocore
 * @date           2025
 * 
 * @details
 * Unit tests for CH375 core functionality including existence check,
 * version query, USB mode setting, status retrieval, device connection,
 * token sending, and block data transfers. Depends on mock hardware layer.
 * 
 * @copyright 
 * Copyright (c) 2025 akaDestrocore
 * This program is free software: you can redistribute it and/or modify
 * it under the terms of the GNU General Public License as published by
 * the Free Software Foundation, either version 3 of the License, or
 * (at your option) any later version.
 */

#include <zephyr/ztest.h>
#include "usb_stubs.h"
#include "ch375.h"
#include "mock_ch375_hw.h"

static struct ch375_Context_t *pCtx;

static void test_setup(void *f)
{
    mock_ch375Reset();
    zassert_equal(mock_ch375Init(&pCtx), CH375_SUCCESS);
}

static void test_teardown(void *f)
{
    if (pCtx) {
        ch375_closeContext(pCtx);
        pCtx = NULL;
    }
}

/* ========================================================================
 * Test: CH375 Existence Check
 * ======================================================================== */
ZTEST(ch375_core, test_checkexist_success)
{
    // Expected response: ~0x65 = 0x9A
    mock_ch375QueueResponse(CH375_CHECK_EXIST_DATA2);
    
    int ret = ch375_checkExist(pCtx);
    
    zassert_equal(ret, CH375_SUCCESS, "Check exist should succeed");
    zassert_true(mock_ch375VerifyCmdSent(CH375_CMD_CHECK_EXIST), "CHECK_EXIST command should be sent");
    zassert_equal(mock_ch375GetLastData(), CH375_CHECK_EXIST_DATA1, "Should send 0x65 as data");
}

ZTEST(ch375_core, test_checkexist_wrong_response)
{
    // Queue wrong response
    mock_ch375QueueResponse(0x42);
    
    int ret = ch375_checkExist(pCtx);
    
    zassert_equal(ret, CH375_NO_EXIST, "Should fail with wrong response");
}

ZTEST(ch375_core, test_checkexist_timeout)
{
    // Don't queue any response
    int ret = ch375_checkExist(pCtx);
    
    zassert_equal(ret, CH375_READ_DATA_FAILED, "Should timeout without response");
}

/* ========================================================================
 * Test: Get Version
 * ======================================================================== */
ZTEST(ch375_core, test_get_version_success)
{
    uint8_t version = 0;
    
    // CH375 version is in lower 6 bits
    mock_ch375QueueResponse(0x43);
    
    int ret = ch375_getVersion(pCtx, &version);
    
    zassert_equal(ret, CH375_SUCCESS);
    zassert_equal(version, 0x03, "Should mask to lower 6 bits");
    zassert_true(mock_ch375VerifyCmdSent(CH375_CMD_GET_IC_VER));
}

ZTEST(ch375_core, test_get_version_null_param)
{
    int ret = ch375_getVersion(pCtx, NULL);
    
    zassert_equal(ret, CH375_PARAM_INVALID);
}

/* ========================================================================
 * Test: Set USB Mode
 * ======================================================================== */
ZTEST(ch375_core, test_set_usb_mode_host)
{
    mock_ch375QueueResponse(CH375_CMD_RET_SUCCESS);
    
    int ret = ch375_setUSBMode(pCtx, CH375_USB_MODE_SOF_AUTO);
    
    zassert_equal(ret, CH375_SUCCESS);
    zassert_true(mock_ch375VerifyCmdSent(CH375_CMD_SET_USB_MODE));
}

ZTEST(ch375_core, test_set_usb_mode_failure)
{
    mock_ch375QueueResponse(CH375_CMD_RET_FAILED);
    
    int ret = ch375_setUSBMode(pCtx, CH375_USB_MODE_SOF_AUTO);
    
    zassert_equal(ret, CH375_ERROR, "Should fail with error response");
}

/* ========================================================================
 * Test: Get Status
 * ======================================================================== */
ZTEST(ch375_core, test_get_status)
{
    uint8_t status = 0;
    mock_ch375QueueStatus(CH375_USB_INT_SUCCESS);
    
    int ret = ch375_getStatus(pCtx, &status);
    
    zassert_equal(ret, CH375_SUCCESS);
    zassert_equal(status, CH375_USB_INT_SUCCESS);
    zassert_true(mock_ch375VerifyCmdSent(CH375_CMD_GET_STATUS));
}

/* ========================================================================
 * Test: Test Connect
 * ======================================================================== */
ZTEST(ch375_core, test_connect_device_connected)
{
    uint8_t connStatus = 0;
    mock_ch375QueueResponse(CH375_USB_INT_CONNECT);
    
    int ret = ch375_testConnect(pCtx, &connStatus);
    
    zassert_equal(ret, CH375_SUCCESS);
    zassert_equal(connStatus, CH375_USB_INT_CONNECT);
}

ZTEST(ch375_core, test_connect_device_disconnected)
{
    uint8_t connStatus = 0;
    
    // First response for testConnect
    mock_ch375QueueResponse(CH375_USB_INT_DISCONNECT);
    // Second response for getStatus called internally
    mock_ch375QueueStatus(0x00);
    
    int ret = ch375_testConnect(pCtx, &connStatus);
    
    zassert_equal(ret, CH375_SUCCESS);
    zassert_equal(connStatus, CH375_USB_INT_DISCONNECT);
}

/* ========================================================================
 * Test: Wait for INT
 * ======================================================================== */
ZTEST(ch375_core, test_wait_int_immediate)
{
    mock_ch375QueueStatus(CH375_USB_INT_SUCCESS);
    
    int ret = ch375_waitInt(pCtx, 1000);
    
    zassert_equal(ret, CH375_SUCCESS);
}

ZTEST(ch375_core, test_wait_int_after_polling)
{
    mock_ch375QueueStatus(0x00);
    mock_ch375QueueStatus(0x00);
    mock_ch375QueueStatus(0x00);
    mock_ch375QueueStatus(CH375_USB_INT_SUCCESS);
    
    int ret = ch375_waitInt(pCtx, 1000);
    
    zassert_equal(ret, CH375_SUCCESS);
}

ZTEST(ch375_core, test_wait_int_timeout)
{
    // Set default status to other value
    mock_ch375SetDefaultStatus(0x00);
    
    int ret = ch375_waitInt(pCtx, 10);
    
    zassert_equal(ret, CH375_TIMEOUT);
}

/* ========================================================================
 * Test: Send Token
 * ======================================================================== */
ZTEST(ch375_core, test_send_token_setup)
{
    uint8_t status;

    // Queue statuses for ch375_waitInt() polling
    mock_ch375QueueStatus(0x00);
    mock_ch375QueueStatus(0x00);
    mock_ch375QueueStatus(CH375_USB_INT_SUCCESS);
    // Final getStatus call
    mock_ch375QueueStatus(CH375_USB_INT_SUCCESS);
    
    int ret = ch375_sendToken(pCtx, 0, false, USB_PID_SETUP, &status);
    
    zassert_equal(ret, CH375_SUCCESS);
    zassert_equal(status, CH375_USB_INT_SUCCESS);
    zassert_true(mock_ch375VerifyCmdSent(CH375_CMD_ISSUE_TKN_X));
}

ZTEST(ch375_core, test_send_token_in)
{
    uint8_t status;
    
    // Queue statuses for polling
    mock_ch375QueueStatus(0x00);
    mock_ch375QueueStatus(0x00);
    mock_ch375QueueStatus(CH375_USB_INT_SUCCESS);
    mock_ch375QueueStatus(CH375_USB_INT_SUCCESS);
    
    int ret = ch375_sendToken(pCtx, 0, true, USB_PID_IN, &status);
    
    zassert_equal(ret, CH375_SUCCESS);
    zassert_equal(status, CH375_USB_INT_SUCCESS);
    
    // Verify toggle bit set (0xC0)
    uint8_t history[10];
    int count;
    mock_ch375GetDataHistory(history, &count, 10);
    zassert_true(count >= 2);
    zassert_equal(history[count-2], 0xC0, "DATA1 toggle should be 0xC0");
}

/* ========================================================================
 * Test: Block Data Read/Write
 * ======================================================================== */
ZTEST(ch375_core, test_write_block_data)
{
    uint8_t data[] = {0x01, 0x02, 0x03, 0x04};
    
    int ret = ch375_writeBlockData(pCtx, data, sizeof(data));
    
    zassert_equal(ret, CH375_SUCCESS);
    zassert_true(mock_ch375VerifyCmdSent(CH375_CMD_WR_USB_DATA7));
    
    // Verify data was written
    uint8_t history[10];
    int count;
    mock_ch375GetDataHistory(history, &count, 10);
    zassert_equal(count, 5, "Should write length + 4 bytes");
    zassert_equal(history[0], 4, "First byte should be length");
    zassert_mem_equal(&history[1], data, 4, "Data should match");
}

ZTEST(ch375_core, test_read_block_data)
{
    uint8_t buffer[10];
    uint8_t actualLen;
    
    // Queue response: length + data
    uint8_t response[] = {4, 0xAA, 0xBB, 0xCC, 0xDD};
    mock_ch375QueueResponses(response, sizeof(response));
    
    int ret = ch375_readBlockData(pCtx, buffer, sizeof(buffer), &actualLen);
    
    zassert_equal(ret, CH375_SUCCESS);
    zassert_equal(actualLen, 4);
    zassert_equal(buffer[0], 0xAA);
    zassert_equal(buffer[3], 0xDD);
}

ZTEST(ch375_core, test_read_block_data_short_packet)
{
    uint8_t buffer[10];
    uint8_t actualLen;
    
    // Queue: length says 10, but only 3 bytes available
    mock_ch375QueueResponse(10);
    mock_ch375QueueResponse(0x11);
    mock_ch375QueueResponse(0x22);
    mock_ch375QueueResponse(0x33);
    // No more data should cause timeout
    
    int ret = ch375_readBlockData(pCtx, buffer, sizeof(buffer), &actualLen);
    
    zassert_equal(ret, CH375_SUCCESS);
    zassert_equal(actualLen, 3, "Should return actual bytes read");
}

/* ========================================================================
 * Test Suite Setup
 * ======================================================================== */
ZTEST_SUITE(ch375_core, NULL, NULL, test_setup, test_teardown, NULL);
```

## src/test_descriptors.c
```c
/* SPDX-License-Identifier: GPL-3.0-or-later */
/**
 * ╔═══════════════════════════════════════════════════════════════════════╗
 * ║                          GhostHIDe Project                            ║
 * ╚═══════════════════════════════════════════════════════════════════════╝
 * 
 * @file           test_descriptors.c
 * @brief          USB descriptor parsing unit tests
 * 
 * @author         destrocore
 * @date           2025
 * 
 * @details
 * Unit tests for USB descriptor parsing including device, configuration,
 * interface, endpoint, and HID descriptors. Tests multi-interface configs,
 * malformed descriptor detection, and endpoint type/direction parsing.
 * 
 * @copyright 
 * Copyright (c) 2025 akaDestrocore
 * This program is free software: you can redistribute it and/or modify
 * it under the terms of the GNU General Public License as published by
 * the Free Software Foundation, either version 3 of the License, or
 * (at your option) any later version.
 */

#include <zephyr/ztest.h>
#include <zephyr/usb/usb_ch9.h>
#include "usb_stubs.h"
#include "ch375_host.h"
#include "mock_ch375_hw.h"

static struct ch375_Context_t *pCtx;

/**
 * @brief Sample USB Device Descriptor
 */
static const uint8_t sampleDeviceDesc[] = {
    0x12,                       // bLength
    0x01,                       // bDescriptorType: DEVICE
    0x00, 0x02,                 // bcdUSB: 2.0 (LE)
    0x00,                       // bDeviceClass
    0x00,                       // bDeviceSubClass
    0x00,                       // bDeviceProtocol
    0x40,                       // bMaxPacketSize0: 64
    0x5E, 0x04,                 // idVendor: 0x045E (Microsoft)
    0x3B, 0x00,                 // idProduct: 0x003B
    0x20, 0x01,                 // bcdDevice: 1.20
    0x01,                       // iManufacturer
    0x02,                       // iProduct
    0x00,                       // iSerialNumber
    0x01                        // bNumConfigurations
};

/**
 * @brief Sample USB Mouse Configuration Descriptor
 */
static const uint8_t sampleMouseConfig[] = {
    // Config Descriptor
    0x09,                       // bLength
    0x02,                       // bDescriptorType: CONFIGURATION
    0x22, 0x00,                 // wTotalLength: 34 bytes
    0x01,                       // bNumInterfaces
    0x01,                       // bConfigurationValue
    0x00,                       // iConfiguration
    0xA0,                       // bmAttributes: Remote wakeup
    0x32,                       // bMaxPower: 100mA

    // Interface Descriptor
    0x09,                       // bLength
    0x04,                       // bDescriptorType: INTERFACE
    0x00,                       // bInterfaceNumber
    0x00,                       // bAlternateSetting
    0x01,                       // bNumpEndpoints
    0x03,                       // bInterfaceClass: HID
    0x01,                       // bInterfaceSubClass: Boot
    0x02,                       // bInterfaceProtocol: Mouse
    0x00,                       // iInterface

    // HID Descriptor
    0x09,                       // bLength
    0x21,                       // bDescriptorType: HID
    0x11, 0x01,                 // bcdHID: 1.11
    0x00,                       // bCountryCode
    0x01,                       // bNumDescriptors
    0x22,                       // bDescriptorType: Report
    0x34, 0x00,                 // wDescriptorLength: 52

    // pEndpoint Descriptor
    0x07,                       // bLength
    0x05,                       // bDescriptorType: pEndPOINT
    0x81,                       // bEndpointAddress: IN pEndpoint 1
    0x03,                       // bmAttributes: Interrupt
    0x04, 0x00,                 // wMaxPacketSize: 4
    0x0A                        // bInterval: 10ms
};

/**
 * @brief Sample USB Keyboard Configuration with multiple pEndpoints
 */
static const uint8_t sampleKeyboardConfig[] = {
    // Configuration descriptor
    0x09, 0x02, 0x3b, 0x00, 0x02, 0x01, 0x00, 0xA0, 0x32,
    // Interface descriptor, keyboard
    0x09, 0x04, 0x00, 0x00, 0x01, 0x03, 0x01, 0x01, 0x00,
    // HID class descriptor
    0x09, 0x21, 0x11, 0x01, 0x00, 0x01, 0x22, 0x3e, 0x00,
    // Endpoint descriptor
    0x07, 0x05, 0x84, 0x03, 0x08, 0x00, 0x0a,
    // Interface descriptor, media/consumer
    0x09, 0x04, 0x01, 0x00, 0x01, 0x03, 0x00, 0x00, 0x00,
    // HID class descriptor
    0x09, 0x21, 0x10, 0x01, 0x00, 0x01, 0x22, 0x34, 0x00,
    // Endpoint descriptor
    0x07, 0x05, 0x87, 0x03, 0x04, 0x00, 0x0a
};


static const struct usb_desc_header *find_descriptor_of_type(
    const uint8_t *pBuf, size_t buflen, uint8_t descType, unsigned int nth) {
    
    const uint8_t *pCur = pBuf;
    const uint8_t *pEnd = pBuf + buflen;
    unsigned int found = 0;

    while (pCur + sizeof(struct usb_desc_header) <= pEnd) {
        const struct usb_desc_header *pHdr = (const struct usb_desc_header *)pCur;

        if (0 == pHdr->bLength) {
            return NULL;
        }
        if (pCur + pHdr->bLength > pEnd) {
            return NULL;
        }

        if (pHdr->bDescriptorType == descType) {
            if (found == nth) {
                return pHdr;
            }
            found++;
        }

        pCur += pHdr->bLength;
    }

    return NULL;
}

static const struct usb_desc_header *find_descriptor_from_offset(
    const uint8_t *pBuff, size_t buflen, size_t offset, uint8_t descType)
{
    if (offset >= buflen) {
        return NULL;
    }
    return find_descriptor_of_type(pBuff + offset, buflen - offset, descType, 0);
}

static void test_setup(void *f) {

    mock_ch375Reset();
    zassert_equal(mock_ch375Init(&pCtx), CH375_SUCCESS);
}

static void test_teardown(void *f) {

    if (NULL != pCtx) {
        ch375_closeContext(pCtx);
        pCtx = NULL;
    }
}

/* ========================================================================
 * Test: Device Descriptor Parsing
 * ======================================================================== */
ZTEST(ch375_descriptors, test_parse_device_descriptor_basic) {

    const struct usb_device_descriptor *pDesc = (const struct usb_device_descriptor *)sampleDeviceDesc;

    zassert_equal(pDesc->bLength, 18);
    zassert_equal(pDesc->bDescriptorType, USB_DESC_DEVICE);
    zassert_true(8 == pDesc->bMaxPacketSize0 || 16 == pDesc->bMaxPacketSize0 ||
                32 == pDesc->bMaxPacketSize0 || 64 == pDesc->bMaxPacketSize0);

    zassert_equal(sys_le16_to_cpu(pDesc->bcdUSB), 0x0200);
    zassert_equal(pDesc->bMaxPacketSize0, 64);
    zassert_equal(sys_le16_to_cpu(pDesc->idVendor), 0x045E);
    zassert_equal(sys_le16_to_cpu(pDesc->idProduct), 0x003B);
}

 /* ========================================================================
 * Test: Configuration Descriptor Parsing
 * ======================================================================== */
ZTEST(ch375_descriptors, test_parse_config_descriptor_basic) {

    const struct usb_cfg_descriptor *pCfg = (const struct usb_cfg_descriptor *)sampleMouseConfig;

    zassert_equal(pCfg->bLength, 9);
    zassert_equal(pCfg->bDescriptorType, USB_DESC_CONFIGURATION);
    zassert_equal(sys_le16_to_cpu(pCfg->wTotalLength), 34);
    zassert_equal(pCfg->bNumInterfaces, 1);
    zassert_equal(pCfg->bConfigurationValue, 1);

    zassert_true(sys_le16_to_cpu(pCfg->wTotalLength) <= sizeof(sampleMouseConfig));
}

/* ========================================================================
 * Test: Interface Descriptor Parsing
 * ======================================================================== */
ZTEST(ch375_descriptors, test_parse_interface_descriptor) {

    const struct usb_if_descriptor *pIfDesc = (const struct usb_if_descriptor *)(sampleMouseConfig + 9);

    zassert_equal(pIfDesc->bLength, 9);
    zassert_equal(pIfDesc->bDescriptorType, USB_DESC_INTERFACE);
    zassert_equal(pIfDesc->bInterfaceNumber, 0);
    zassert_equal(pIfDesc->bNumEndpoints, 1);
    zassert_equal(pIfDesc->bInterfaceClass, 0x03, "Should be HID class");
    zassert_equal(pIfDesc->bInterfaceSubClass, 0x01, "Should be Boot subclass");
    zassert_equal(pIfDesc->bInterfaceProtocol, 0x02, "Should be Mouse protocol");
}

/* ========================================================================
 * Test: Endpoint Descriptor Parsing
 * ======================================================================== */
ZTEST(ch375_descriptors, test_parse_endpoint_descriptor) {

    const struct usb_ep_descriptor *pEP = (const struct usb_ep_descriptor *)(sampleMouseConfig + 27);

    zassert_equal(pEP->bLength, 7);
    zassert_equal(pEP->bDescriptorType, USB_DESC_ENDPOINT);
    zassert_equal(pEP->bEndpointAddress, 0x81, "Should be IN endpoint 1");
    zassert_equal(pEP->bmAttributes & 0x03, 0x03, "Should be Interrupt type");
    zassert_equal(sys_le16_to_cpu(pEP->wMaxPacketSize), 4);
    zassert_equal(pEP->bInterval, 10);
}

/* ========================================================================
 * Test: Full Configuration Parsing (Mouse)
 * ======================================================================== */
ZTEST(ch375_descriptors, test_full_mouse_config_walk) {

    const uint8_t *pCur = sampleMouseConfig;
    const uint8_t *pEnd = sampleMouseConfig + sizeof(sampleMouseConfig);
    int descriptor_count = 0;
    int interface_count = 0;
    int endpoint_count = 0;

    while (pCur + sizeof(struct usb_desc_header) <= pEnd) {
        
        const struct usb_desc_header *pHdr = (const struct usb_desc_header *)pCur;

        zassert_not_equal(pHdr->bLength, 0, "Descriptor length cannot be 0");
        zassert_true(pCur + pHdr->bLength <= pEnd, "Descriptor exceeds buffer");

        descriptor_count++;

        switch (pHdr->bDescriptorType) {
        case USB_DESC_CONFIGURATION:
            zassert_equal(descriptor_count, 1, "First descriptor must be configuration");
            break;

        case USB_DESC_INTERFACE:
            interface_count++;
            break;

        case USB_DESC_ENDPOINT:
            endpoint_count++;
            break;

        default:
            break;
        }

        pCur += pHdr->bLength;
    }

    zassert_equal(interface_count, 1, "Mouse should have 1 interface");
    zassert_equal(endpoint_count, 1, "Mouse should have 1 endpoint");
}

/* ========================================================================
 * Test: Multi-Interface Configuration (Keyboard)
 * ======================================================================== */
ZTEST(ch375_descriptors, test_keyboard_multi_interface) {

    const uint8_t *pCur = sampleKeyboardConfig;
    const uint8_t *pEnd = sampleKeyboardConfig + sizeof(sampleKeyboardConfig);
    int interface_count = 0;
    int endpoint_count = 0;
    int current_interface = -1;
    int ep_per_interface[2] = {0, 0};

    while (pCur + sizeof(struct usb_desc_header) <= pEnd) {
        const struct usb_desc_header *pHdr = (const struct usb_desc_header *)pCur;

        if (0 == pHdr->bLength || pCur + pHdr->bLength > pEnd) {
            break;
        }

        if (USB_DESC_INTERFACE == pHdr->bDescriptorType) {
            const struct usb_if_descriptor *iface = (const struct usb_if_descriptor *)pCur;
            current_interface = iface->bInterfaceNumber;
            interface_count++;

            if (0 == current_interface) {
                zassert_equal(iface->bInterfaceClass, 0x03);
                zassert_equal(iface->bInterfaceProtocol, 0x01, "Interface 0 should be keyboard");
            }
        } else if (USB_DESC_ENDPOINT == pHdr->bDescriptorType) {
            endpoint_count++;
            if (current_interface >= 0 && current_interface < 2) {
                ep_per_interface[current_interface]++;
            }
        }

        pCur += pHdr->bLength;
    }

    zassert_equal(interface_count, 2, "Keyboard should have 2 interfaces");
    zassert_equal(endpoint_count, 2, "Should have 2 endpoints total");
    zassert_equal(ep_per_interface[0], 1, "Interface 0 should have 1 EP");
    zassert_equal(ep_per_interface[1], 1, "Interface 1 should have 1 EP");
}

/* ========================================================================
 * Test: Malformed Descriptor Handling
 * ======================================================================== */
ZTEST(ch375_descriptors, test_malformed_zero_length) {

    uint8_t pBadDesc[] = {
        0x09, 0x02, 0x09, 0x00, 0x01, 0x01, 0x00, 0xA0, 0x32,
        0x00
    };

    const uint8_t *pCur = pBadDesc;
    const uint8_t *pEnd = pBadDesc + sizeof(pBadDesc);
    int descCount = 0;

    while (pCur + sizeof(struct usb_desc_header) <= pEnd) {
        const struct usb_desc_header *pHdr = (const struct usb_desc_header *)pCur;

        if (0 == pHdr->bLength) {
            break;
        }

        descCount++;
        pCur += pHdr->bLength;
    }

    zassert_equal(descCount, 1, "Should stop at zero-length descriptor");
}

ZTEST(ch375_descriptors, test_malformed_length_exceeds) {

    uint8_t pBadDesc[] = {
        0x09, 0x02, 0x0F, 0x00, 0x01, 0x01, 0x00, 0xA0, 0x32,
        0xFF, 0x04
    };

    const uint8_t *pCur = pBadDesc;
    const uint8_t *pEnd = pBadDesc + sizeof(pBadDesc);
    bool detected_overflow = false;
    int descCount = 0;

    while (pCur + sizeof(struct usb_desc_header) <= pEnd) {
        const struct usb_desc_header *pHdr = (const struct usb_desc_header *)pCur;

        if (0 == pHdr->bLength || pCur + pHdr->bLength > pEnd) {
            detected_overflow = true;
            break;
        }

        descCount++;
        pCur += pHdr->bLength;
    }

    zassert_true(detected_overflow, "Should detect length overflow");
}

/* ========================================================================
 * Test: HID Descriptor Parsing
 * ======================================================================== */
ZTEST(ch375_descriptors, test_hid_descriptor) {

    const struct usb_desc_header *pHidHdr = find_descriptor_from_offset(sampleMouseConfig, 
        sizeof(sampleMouseConfig), 18, 0x21);

    zassert_not_null(pHidHdr, "HID descriptor not found");

    const uint8_t *pHid = (const uint8_t *)pHidHdr;

    zassert_equal(pHid[0], 9, "HID bLength");
    zassert_equal(pHid[1], 0x21, "HID bDescriptorType");

    uint16_t bcdHID = pHid[2] | (pHid[3] << 8);
    zassert_equal(bcdHID, 0x0111, "HID version 1.11 expected");

    zassert_equal(pHid[5], 0x01, "bNumDescriptors should be 1");
    zassert_equal(pHid[6], 0x22, "class descriptor type should be Report (0x22)");

    uint16_t report_len = pHid[7] | (pHid[8] << 8);
    zassert_equal(report_len, 52, "Report descriptor length should be 52");
}

/* ========================================================================
 * Test: Endpoint Address & Type Detection
 * ======================================================================== */
ZTEST(ch375_descriptors, test_endpoint_direction_detection) {

    uint8_t epInAddr = 0x81;
    zassert_true(epInAddr & 0x80, "Should detect IN direction");

    uint8_t epOutAddr = 0x01;
    zassert_false(epOutAddr & 0x80, "Should detect OUT direction");
}

ZTEST(ch375_descriptors, test_endpoint_type_detection) {

    uint8_t attrInt = 0x03;
    zassert_equal(attrInt & 0x03, 0x03, "Should be Interrupt");

    uint8_t attrBulk = 0x02;
    zassert_equal(attrBulk & 0x03, 0x02, "Should be Bulk");

    uint8_t attrIso = 0x01;
    zassert_equal(attrIso & 0x03, 0x01, "Should be Isochronous");
}

/* -------------------------------------------------------------------------
 * Test suite registration
 * ------------------------------------------------------------------------- */
ZTEST_SUITE(ch375_descriptors, NULL, NULL, test_setup, test_teardown, NULL);
```

## src/test_hid_parser.c
```c
/* SPDX-License-Identifier: GPL-3.0-or-later */
/**
 * ╔═══════════════════════════════════════════════════════════════════════╗
 * ║                          GhostHIDe Project                            ║
 * ╚═══════════════════════════════════════════════════════════════════════╝
 * 
 * @file           test_hid_parser.c
 * @brief          USB HID report descriptor parser unit tests
 * 
 * @author         destrocore
 * @date           2025
 * 
 * @details
 * Unit tests for USB mouse and keyboard descriptor parsing. Tests various
 * report descriptor types.
 * 
 * @copyright 
 * Copyright (c) 2025 akaDestrocore
 * This program is free software: you can redistribute it and/or modify
 * it under the terms of the GNU General Public License as published by
 * the Free Software Foundation, either version 3 of the License, or
 * (at your option) any later version.
 */

#include <zephyr/ztest.h>
#include "mock_ch375_hw.h"
#include "hid_parser.h"

static struct ch375_Context_t *pCtx;
static struct USB_Device_t udev;

/**
 * @brief Sample HID Report Descriptor for a generic 3-button mouse
 */
static const uint8_t HidMouseReportDesc[] = {
    0x05, 0x01,                 // USAGE_PAGE (Generic Desktop)
    0x09, 0x02,                 // USAGE (Mouse)
    0xa1, 0x01,                 // COLLECTION (Application)
    0x09, 0x01,                 //   USAGE (Pointer)
    0xa1, 0x00,                 //   COLLECTION (Physical)
    0x05, 0x09,                 //     USAGE_PAGE (Button)
    0x19, 0x01,                 //     USAGE_MINIMUM (Button 1)
    0x29, 0x03,                 //     USAGE_MAXIMUM (Button 3)
    0x15, 0x00,                 //     LOGICAL_MINIMUM (0)
    0x25, 0x01,                 //     LOGICAL_MAXIMUM (1)
    0x95, 0x03,                 //     REPORT_COUNT (3)
    0x75, 0x01,                 //     REPORT_SIZE (1)
    0x81, 0x02,                 //     INPUT (Data,Var,Abs)
    0x95, 0x01,                 //     REPORT_COUNT (1)
    0x75, 0x05,                 //     REPORT_SIZE (5)
    0x81, 0x03,                 //     INPUT (Cnst,Var,Abs)
    0x05, 0x01,                 //     USAGE_PAGE (Generic Desktop)
    0x09, 0x30,                 //     USAGE (X)
    0x09, 0x31,                 //     USAGE (Y)
    0x15, 0x81,                 //     LOGICAL_MINIMUM (-127)
    0x25, 0x7f,                 //     LOGICAL_MAXIMUM (127)
    0x75, 0x08,                 //     REPORT_SIZE (8)
    0x95, 0x02,                 //     REPORT_COUNT (2)
    0x81, 0x06,                 //     INPUT (Data,Var,Rel)
    0xc0,                       //   END_COLLECTION
    0xc0                        // END_COLLECTION
};

/**
 * @brief Keyboard descriptor
 */
static const uint8_t HidKeyboardReportDesc[] = {
    0x05, 0x01,                 // USAGE_PAGE (Generic Desktop)
    0x09, 0x06,                 // USAGE (Keyboard)
    0xA1, 0x01,                 // COLLECTION (Application)
    0x75, 0x01,                 // REPORT_SIZE (1)
    0x95, 0x08,                 // REPORT_COUNT (8)

    0x05, 0x07,                 // USAGE_PAGE (Key Codes)
    0x19, 0xE0,                 // USAGE_MINIMUM (224)
    0x29, 0xE7,                 // USAGE_MAXIMUM (231)
    0x15, 0x00,                 // LOGICAL_MINIMUM (0)
    0x25, 0x01,                 // LOGICAL_MAXIMUM (1)

    0x81, 0x02,                 // INPUT (Data,Var,Abs)

    0x95, 0x01,                 // REPORT_COUNT (1)
    0x75, 0x08,                 // REPORT_SIZE (8)
    0x81, 0x03,                 // INPUT (Cnst)

    0x95, 0x05,                 // REPORT_COUNT (5)

    0x75, 0x01,                 // REPORT_SIZE (1)
    0x05, 0x08,                 // USAGE_PAGE (LEDs)
    0x19, 0x01,                 // USAGE_MINIMUM (1)
    0x29, 0x05,                 // USAGE_MAXIMUM (5)
    0x91, 0x02,                 // OUTPUT (Data,Var,Abs)

    0x95, 0x01,                 // REPORT_COUNT (1)
    0x75, 0x03,                 // REPORT_SIZE (3)
    0x91, 0x03,                 // OUTPUT (Cnst)

    0x95, 0x06,                 // REPORT_COUNT (6)
    0x75, 0x08,                 // REPORT_SIZE (8)

    0x15, 0x00,                 // LOGICAL_MINIMUM (0)
    0x25, 0x68,                 // LOGICAL_MAXIMUM (104)
    0x05, 0x07,                 // USAGE_PAGE (Key Codes)
    0x19, 0x00,                 // USAGE_MINIMUM (0)
    0x29, 0x68,                 // USAGE_MAXIMUM (104)

    0x81, 0x00,                 // INPUT (Data, Array)
    0xc0                        // END_COLLECTION
};

/**
 * @brief Report ID descriptor
 */
static const uint8_t HidMouseWithReportID[] = {
    0x05, 0x01,                 // USAGE_PAGE (Generic Desktop)
    0x09, 0x02,                 // USAGE (Mouse)
    0xA1, 0x01,                 // COLLECTION (Application)
    0x85, 0x01,                 //   REPORT_ID (1)
    0x09, 0x01,                 //   USAGE (Pointer)
    0xA1, 0x00,                 //   COLLECTION (Physical)
    0x05, 0x09,                 //     USAGE_PAGE (Button)
    0x19, 0x01,                 //     USAGE_MINIMUM (Button 1)
    0x29, 0x05,                 //     USAGE_MAXIMUM (Button 5)
    0x15, 0x00,                 //     LOGICAL_MINIMUM (0)
    0x25, 0x01,                 //     LOGICAL_MAXIMUM (1)
    0x35, 0x00,                 //     PHYSICAL_MINIMUM (0)
    0x45, 0x01,                 //     PHYSICAL_MAXIMUM (1)
    0x65, 0x00,                 //     UNIT (None)
    0x55, 0x00,                 //     UNIT_EXPONENT (0)
    0x75, 0x01,                 //     REPORT_SIZE (1)
    0x95, 0x05,                 //     REPORT_COUNT (5)
    0x81, 0x02,                 //     INPUT (Data,Var,Abs)
    0x95, 0x03,                 //     REPORT_COUNT (3)
    0x81, 0x03,                 //     INPUT (Cnst,Var,Abs)
    0x05, 0x01,                 //     USAGE_PAGE (Generic Desktop)
    0x09, 0x30,                 //     USAGE (X)
    0x26, 0xFF, 0x7F,           //     LOGICAL_MAXIMUM (32767)
    0x45, 0x00,                 //     PHYSICAL_MAXIMUM (0)
    0x75, 0x10,                 //     REPORT_SIZE (16)
    0x95, 0x01,                 //     REPORT_COUNT (1)
    0x81, 0x06,                 //     INPUT (Data,Var,Rel)
    0x09, 0x31,                 //     USAGE (Y)
    0x81, 0x06,                 //     INPUT (Data,Var,Rel)
    0x09, 0x38,                 //     USAGE (Wheel)
    0x25, 0x7F,                 //     LOGICAL_MAXIMUM (127)
    0x75, 0x08,                 //     REPORT_SIZE (8)
    0x81, 0x06,                 //     INPUT (Data,Var,Rel)
    0x05, 0x0C,                 //     USAGE_PAGE (Consumer Devices)
    0x0A, 0x38, 0x02,           //     USAGE (AC Pan)
    0x81, 0x06,                 //     INPUT (Data,Var,Rel)
    0xC1, 0x00,                 //   END_COLLECTION
    0xC1, 0x00                  // END_COLLECTION
};

/**
 * @brief Mouse descriptor with wheel
 */
static const uint8_t MouseWheelReportDesc[] = {
    0x05, 0x01,                 // USAGE_PAGE (Generic Desktop Ctrls)
    0x09, 0x02,                 // USAGE (Mouse)
    0xA1, 0x01,                 // COLLECTION (Application)
    0x09, 0x01,                 //   USAGE (Pointer)
    0xA1, 0x00,                 //   COLLECTION (Physical)
    0x05, 0x09,                 //     USAGE_PAGE (Button)
    0x19, 0x01,                 //     USAGE_MINIMUM (0x01)
    0x29, 0x03,                 //     USAGE_MAXIMUM(0x03)
    0x15, 0x00,                 //     LOGICAL_MINIMUM (0)
    0x25, 0x01,                 //     LOGICAL_MAXIMUM (1)
    0x75, 0x01,                 //     REPORT_SIZE (1)
    0x95, 0x03,                 //     REPORT_COUNT (3)
    0x81, 0x02,                 //     INPUT (Data,Var,Abs,No Wrap,Linear,Preferred State,No Null Position)
    0x75, 0x05,                 //     REPORT_SIZE (5)
    0x95, 0x01,                 //     REPORT_COUNT (1)
    0x81, 0x01,                 //     INPUT (Const,Array,Abs,No Wrap,Linear,Preferred State,No Null Position)
    0x05, 0x01,                 //     USAGE_PAGE (Generic Desktop Ctrls)
    0x09, 0x30,                 //     USAGE (X)
    0x09, 0x31,                 //     USAGE (Y)
    0x09, 0x38,                 //     USAGE (Wheel)
    0x15, 0x81,                 //     LOGICAL_MINIMUM (-127)
    0x25, 0x7F,                 //     LOGICAL_MAXIMUM (127)
    0x75, 0x08,                 //     REPORT_SIZE (8)
    0x95, 0x03,                 //     REPORT_COUNT (3)
    0x81, 0x06,                 //     INPUT (Data,Var,Rel,No Wrap,Linear,Preferred State,No Null Position)
    0xC0,                       //   END_COLLECTION
    0xC0,                       // END_COLLECTION
};

static void test_setup(void *f) {
    
    mock_ch375Reset();
    zassert_equal(mock_ch375Init(&pCtx), CH375_SUCCESS);
    
    memset(&udev, 0x00, sizeof(udev));
    udev.ctx = pCtx;
}

static void test_teardown(void *f) {
    
    if (NULL != pCtx) {
        ch375_closeContext(pCtx);
        pCtx = NULL;
    }
}

/* ========================================================================
 * Test: HID Item Parsing
 * ======================================================================== */
ZTEST(hid_parser, test_fetch_item_short_0byte) {
    // No pData
    uint8_t pData[] = {0x00};
    struct HID_Item_t item;
    
    uint8_t *pNext = HID_fetchItem(pData, pData + sizeof(pData), &item);
    
    zassert_not_null(pNext);
    zassert_equal(item.format, HID_ITEM_FORMAT_SHORT);
    zassert_equal(item.size, 0);
    zassert_equal(pNext - pData, 1);
}

ZTEST(hid_parser, test_fetch_item_short_1byte) {
    // Generic Desktop
    uint8_t pData[] = {0x05, 0x01};
    struct HID_Item_t item;
    
    uint8_t *pNext = HID_fetchItem(pData, pData + sizeof(pData), &item);
    
    zassert_not_null(pNext);
    zassert_equal(item.format, HID_ITEM_FORMAT_SHORT);
    zassert_equal(item.type, HID_ITEM_TYPE_GLOBAL);
    zassert_equal(item.tag, HID_GLOBAL_ITEM_TAG_USAGE_PAGE);
    zassert_equal(item.size, 1);
    zassert_equal(item.data.u8, 0x01);
}

ZTEST(hid_parser, test_fetch_item_short_2byte) {
    // Logical Minimum (-127)
    uint8_t pData[] = {0x16, 0x81, 0xFF};
    struct HID_Item_t item;
    
    uint8_t *pNext = HID_fetchItem(pData, pData + sizeof(pData), &item);
    
    zassert_not_null(pNext);
    zassert_equal(item.format, HID_ITEM_FORMAT_SHORT);
    zassert_equal(item.size, 2);
    zassert_equal(item.data.s16, -127);
}

ZTEST(hid_parser, test_fetch_item_short_4byte) {
    // 4 bytes
    uint8_t pData[] = {0x27, 0xFF, 0x00, 0x00, 0x00, 0x00};
    struct HID_Item_t item;
    
    uint8_t *pNext = HID_fetchItem(pData, pData + sizeof(pData), &item);
    
    zassert_not_null(pNext);
    zassert_equal(item.format, HID_ITEM_FORMAT_SHORT);
    zassert_equal(item.size, 4);
    zassert_equal(item.data.u32, 0x000000FF);
}

ZTEST(hid_parser, test_fetch_item_buffer_overflow) {
    // Incomplete item
    uint8_t pData[] = {0x05};
    struct HID_Item_t item;
    
    uint8_t *pNext = HID_fetchItem(pData, pData + sizeof(pData), &item);
    
    zassert_is_null(pNext, "Should detect buffer overflow");
}

/* ========================================================================
 * Test: Report Descriptor Type Detection
 * ======================================================================== */
ZTEST(hid_parser, test_parse_mouse_descriptor) {
    
    uint8_t detectedType = 0;
    
    int ret = HID_parseReportDescriptor(
        (uint8_t *)HidMouseReportDesc,
        sizeof(HidMouseReportDesc),
        &detectedType
    );
    
    zassert_equal(ret, 0);
    zassert_equal(detectedType, USBHID_TYPE_MOUSE);
}

ZTEST(hid_parser, test_parse_keyboard_descriptor) {
    
    uint8_t detectedType = 0;
    
    int ret = HID_parseReportDescriptor(
        (uint8_t *)HidKeyboardReportDesc,
        sizeof(HidKeyboardReportDesc),
        &detectedType
    );
    
    zassert_equal(ret, 0);
    zassert_equal(detectedType, USBHID_TYPE_KEYBOARD);
}

ZTEST(hid_parser, test_parse_mouse_with_wheel) {
    
    uint8_t detectedType = 0;
    
    int ret = HID_parseReportDescriptor(
        (uint8_t *)MouseWheelReportDesc,
        sizeof(MouseWheelReportDesc),
        &detectedType
    );
    
    zassert_equal(ret, 0);
    zassert_equal(detectedType, USBHID_TYPE_MOUSE);
}

ZTEST(hid_parser, test_parse_invalid_descriptor) {
    
    uint8_t pInvalid[] = {0xC0, 0xFF, 0xEE};
    uint8_t detectedType = 0;
    
    int ret = HID_parseReportDescriptor(pInvalid, sizeof(pInvalid), &detectedType);
    
    zassert_not_equal(ret, 0, "Should fail on invalid descriptor");
}

/* ========================================================================
 * Test: Report Buffer Management
 * ======================================================================== */
ZTEST(hid_parser, test_alloc_report_buffer) {
    
    struct USBHID_Device_t hid_dev;
    memset(&hid_dev, 0x00, sizeof(hid_dev));
    
    int ret = USBHID_allocReportBuffer(&hid_dev, 8);
    
    zassert_equal(ret, USBHID_SUCCESS);
    zassert_not_null(hid_dev.report_buffer);
    zassert_equal(hid_dev.report_len, 8);
    // Double buffered
    zassert_equal(hid_dev.report_buff_len, 16);  
    
    USBHID_freeReportBuffer(&hid_dev);
}

ZTEST(hid_parser, test_get_report_buffer_current) {
    
    struct USBHID_Device_t hid_dev;
    memset(&hid_dev, 0x00, sizeof(hid_dev));
    
    USBHID_allocReportBuffer(&hid_dev, 4);
    
    uint8_t *pBuffer;
    uint32_t len;
    int ret = USBHID_getReportBuffer(&hid_dev, &pBuffer, &len, false);
    
    zassert_equal(ret, USBHID_SUCCESS);
    zassert_not_null(pBuffer);
    zassert_equal(len, 4);
    
    USBHID_freeReportBuffer(&hid_dev);
}

ZTEST(hid_parser, test_get_report_buffer_last) {
    
    struct USBHID_Device_t hid_dev;
    memset(&hid_dev, 0x00, sizeof(hid_dev));
    
    USBHID_allocReportBuffer(&hid_dev, 4);
    
    uint8_t *pBuffer;
    uint32_t len;
    int ret = USBHID_getReportBuffer(&hid_dev, &pBuffer, &len, true);
    
    zassert_equal(ret, USBHID_SUCCESS);
    zassert_not_null(pBuffer);
    zassert_equal(len, 4);
    
    USBHID_freeReportBuffer(&hid_dev);
}

ZTEST(hid_parser, test_double_alloc_fails) {
    
    struct USBHID_Device_t hid_dev;
    memset(&hid_dev, 0x00, sizeof(hid_dev));
    
    USBHID_allocReportBuffer(&hid_dev, 4);
    int ret = USBHID_allocReportBuffer(&hid_dev, 4);
    
    zassert_equal(ret, USBHID_ERROR, "Should fail on double allocation");
    
    USBHID_freeReportBuffer(&hid_dev);
}

/* ========================================================================
 * Test: Report ID Detection
 * ======================================================================== */
ZTEST(hid_parser, test_report_id_detection) {
    
    uint8_t detectedType = 0;
    
    // Parse descriptor with Report ID
    int ret = HID_parseReportDescriptor(
        (uint8_t *)HidMouseWithReportID,
        sizeof(HidMouseWithReportID),
        &detectedType
    );
    
    zassert_equal(ret, 0);
    zassert_equal(detectedType, USBHID_TYPE_MOUSE);
    
    // Verify Report ID item is present in descriptor
    struct HID_Item_t item;
    uint8_t *pCur = (uint8_t *)HidMouseWithReportID;
    uint8_t *pEnd = pCur + sizeof(HidMouseWithReportID);
    bool isReportIDFound = false;
    
    while (pCur < pEnd) {
        pCur = HID_fetchItem(pCur, pEnd, &item);
        if (NULL == pCur) {
            break;
        }
        
        if (HID_ITEM_TYPE_GLOBAL == item.type && HID_GLOBAL_ITEM_TAG_REPORT_ID == item.tag) {
            isReportIDFound = true;
            zassert_equal(item.data.u8, 1, "Report ID should be 1");
            break;
        }
    }
    
    zassert_true(isReportIDFound, "Should detect Report ID tag");
}

/* ========================================================================
 * Test: Collection Depth Tracking
 * ======================================================================== */
ZTEST(hid_parser, test_collection_nesting) {
    
    struct HID_Item_t item;
    uint8_t *pCur = (uint8_t *)HidMouseReportDesc;
    uint8_t *pEnd = pCur + sizeof(HidMouseReportDesc);
    int collectionDepth = 0;
    int maxDepth = 0;
    
    while (pCur < pEnd) {
        pCur = HID_fetchItem(pCur, pEnd, &item);
        if (NULL == pCur) {
            break;
        }
        
        if (HID_ITEM_TYPE_MAIN == item.type) {
            if (HID_MAIN_ITEM_TAG_BEGIN_COLLECTION == item.tag) {
                collectionDepth++;
                if (collectionDepth > maxDepth) {
                    maxDepth = collectionDepth;
                }
            } else if (HID_MAIN_ITEM_TAG_END_COLLECTION == item.tag) {
                collectionDepth--;
            }
        }
    }
    
    zassert_equal(collectionDepth, 0, "Collections should be balanced");
    zassert_equal(maxDepth, 2, "Mouse descriptor has 2 nested collections");
}

/* ========================================================================
 * Test: Edge Cases
 * ======================================================================== */
ZTEST(hid_parser, test_null_parameters) {
    
    struct HID_Item_t item;
    uint8_t pData[] = {0x05, 0x01};
    
    // Null start pointer
    zassert_is_null(HID_fetchItem(NULL, pData + 2, &item));
    
    // Null end pointer
    zassert_is_null(HID_fetchItem(pData, NULL, &item));
    
    // Null item pointer
    zassert_is_null(HID_fetchItem(pData, pData + 2, NULL));
}

ZTEST(hid_parser, test_empty_buffer) {
    
    struct HID_Item_t item;
    uint8_t pData[] = {0x00};
    
    uint8_t *pResult = HID_fetchItem(pData, pData, &item);
    
    zassert_is_null(pResult, "Should handle empty buffer");
}

ZTEST(hid_parser, test_report_buffer_not_allocated) {
    
    struct USBHID_Device_t hid_dev;
    memset(&hid_dev, 0x00, sizeof(hid_dev));
    
    uint8_t *pBuffer;
    uint32_t len;
    int ret = USBHID_getReportBuffer(&hid_dev, &pBuffer, &len, false);
    
    zassert_equal(ret, USBHID_BUFFER_NOT_ALLOC);
}

/* ========================================================================
 * Test Suite Setup
 * ======================================================================== */
ZTEST_SUITE(hid_parser, NULL, NULL, test_setup, test_teardown, NULL);
```
